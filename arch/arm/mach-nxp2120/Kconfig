## arch/arm/mach-nxp2120/Kconfig
```kconfig
if ARCH_NXP2120

config TARGET_MOST2120
	bool "most2120 board"
	
config NAND_NXP2120
	bool "nxp2120 nand"
	default y
	
config SYS_I2C_NXP2120
	bool "nxp2120 i2c"
	default y
	
config NXP2120_SERIAL
	bool "nxp2120 serial"
	default y
	
source "board/nxp2120/most2120/Kconfig"


endif
```

## board/nxp2120/most2120/Kconfig
```kconfig
if TARGET_MOST2120

config SYS_BOARD
	default "most2120"
	
config SYS_VENDOR
	default "nxp2120"
	
config SYS_SOC
	default "nxp2120"
	
config SYS_CONFIG_NAME
	default "most2120"
	
endif
```

## drivers/usb/eth/Kconfig
```kconfig
config USB_EMUL
	bool "Support for USB device emulation"
	depends on DM_USB && SANDBOX
	help
	  Since sandbox does not have access to a real USB bus, it is possible
	  to use device emulators instead. This allows testing of the USB
	  stack on sandbox without needing a real device, or any host machine
	  USB resources.

config USB_HOST_ETHER
	bool "Support for USB host ethernet"
	default y
	
config USB_ETHER_ASIX
	bool "Support for USB ethernet ASIX"
	default n
	
config USB_ETHER_ASIX88179
	bool "Support for USB ethernet ASIX88179"
	default n

config USB_ETHER_MCS7830
	bool "Support for USB ethernet MCS7830"
	default n

config USB_ETHER_SMSC95XX
	bool "Support for USB ethernet SMSC95XX"
	default n

config USB_ETHER_RTL8152
	bool "Support for USB ethernet RTL8152"
	depends on ARCH_SUNXI
	default n
```
